/* ================================================================
 * 蜂鸣器模块 - 源文件
 * 
 * 【新手必读】
 * 这个模块是整个项目中最简单的驱动，因为它只需要控制一个 IO 口
 * 输出高/低电平。通过这个模块你将学到：
 * 
 * 1. GPIO 推挽输出的概念
 * 2. HAL 库 GPIO 操作函数
 * 3. BSRR 寄存器的位操作（STM32 特有的高效 IO 控制方式）
 * 4. 阻塞延时的用法和局限性
 * 
 * 【BSRR 寄存器精讲】
 * STM32 的每个 GPIO 端口都有一个 BSRR 寄存器（32位）：
 *   BSRR = Bit Set/Reset Register（位设置/复位寄存器）
 *   
 *   写操作规则（非常重要！）：
 *   - 写 bit0~bit15（低16位）：对应引脚输出高电平（Set）
 *   - 写 bit16~bit31（高16位）：对应引脚输出低电平（Reset）
 *   - 写 0 到任何位：不操作（无影响）
 *   
 *   例：让 PB0 输出高 → GPIOB->BSRR = (1 << 0)   = 0x00000001
 *       让 PB0 输出低 → GPIOB->BSRR = (1 << 16)  = 0x00010000
 *       让 PB3 输出高 → GPIOB->BSRR = (1 << 3)   = 0x00000008
 *       让 PB3 输出低 → GPIOB->BSRR = (1 << 19)  = 0x00080000
 *   
 *   为什么用 BSRR 而不是直接写 ODR？
 *   因为 BSRR 是原子操作，写0不影响其他位，不会出现"读-改-写"竞态。
 *   HAL_GPIO_WritePin 底层也是用 BSRR 实现的。
 * 
 * 【阻塞延时 vs 非阻塞延时】
 *   HAL_Delay(ms) = 阻塞式延时，CPU 在这段时间内"傻等"不做其他事。
 *   对于蜂鸣器这种简单场景，阻塞延时完全够用。
 *   后续学到定时器中断后，可以用定时器实现精确的非阻塞延时。
 * ================================================================ */

#include "buzzer.h"

/* ================================================================
 * 短促"滴"一声
 * 
 * 例：Buzzer_BeepShort(100);  → PB0 高电平 100ms，然后低电平
 * 
 * 这适用于：
 * - 按键反馈音（50ms）
 * - 开机提示音（100~200ms）  
 * - 测距完成提示（50ms）
 * ================================================================ */
void Buzzer_BeepShort(uint16_t duration_ms)
{
    BUZZER_ON();               // PB0 = 高电平 → 蜂鸣器响
    HAL_Delay(duration_ms);    // 等 duration_ms 毫秒（阻塞，CPU 傻等）
    BUZZER_OFF();              // PB0 = 低电平 → 蜂鸣器停
}

/* ================================================================
 * 长鸣一声
 * 
 * 和短促声逻辑一样，只是延时更长。用于开机/重启提示等场景。
 * ================================================================ */
void Buzzer_BeepLong(uint16_t duration_ms)
{
    BUZZER_ON();
    HAL_Delay(duration_ms);
    BUZZER_OFF();
}

/* ================================================================
 * 连续急促报警音（SOS 模式）
 * 
 * 循环 count 次：响 → 停 → 响 → 停 → ...
 * 间隔很短（100ms），听起来就是"滴滴滴滴滴"的急促声。
 * count = 0 时一直循环，需要外部调用 Buzzer_Stop() 来停。
 * 
 * 适用场景：距离低于报警阈值时触发
 * 
 * 实现细节：
 *   循环中每次先 ON → 延时 80ms → OFF → 延时 100ms
 *   这样间隔是 100ms，听起来比正常 Beep 更急促
 * ================================================================ */
void Buzzer_Alarm_SOS(uint8_t count)
{
    if (count == 0) {
        /* count=0 表示无限循环，由外部停止 */
        while (1) {
            BUZZER_ON();
            HAL_Delay(80);      // 响 80ms
            BUZZER_OFF();
            HAL_Delay(100);     // 停 100ms（间隔）
        }
    } else {
        /* 指定次数循环 */
        for (uint8_t i = 0; i < count; i++) {
            BUZZER_ON();
            HAL_Delay(80);
            BUZZER_OFF();
            HAL_Delay(100);
        }
    }
}

/* ================================================================
 * 停止蜂鸣器
 * 
 * 确保 PB0 回到低电平，蜂鸣器关闭。
 * ================================================================ */
void Buzzer_Stop(void)
{
    BUZZER_OFF();
}
