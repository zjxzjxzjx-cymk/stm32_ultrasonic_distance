/**
 ******************************************************************************
 * @file       ssd1306.c
 * @brief      SSD1306 OLED 驱动（完全参照野火 bsp_i2c_oled.c + bsp_fonts.c）
 *             
 *  架构：直接写入 GDDRAM，无帧缓冲。所有绘制立即通过 I2C 发送到屏幕。
 *  字库：逐字节复制自野火 bsp_fonts.c，经过实际项目验证。
 *  用途：配合 main.c 中的 API 调用（ShowString_6x8 / ShowNum / ClearBuffer 等）
 ******************************************************************************
 */

#include "ssd1306.h"

/* ================================================================
 * 6x8 ASCII 字库 — 逐字节复制自 bsp_fonts.c (野火/embedfire)
 * 95 个字符：空格 ' ' ~ '~'
 * 取模方式：共阴——列行式——逆向输出
 * ================================================================ */
static const uint8_t Font6x8[][6] = {
    {0x00,0x00,0x00,0x00,0x00,0x00}, /*" ",0*/
    {0x00,0x00,0x4C,0x40,0x00,0x00}, /*"!",1*/
    {0x00,0x02,0x02,0x02,0x00,0x00}, /*""",2*/
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    {0x00,0x01,0x01,0x02,0x02,0x00}, /*"~",94*/
};

/*
 * 8x16 ASCII 字库 — 仅数字 0-9，逐字节复制自 bsp_fonts.c
 * 前 8 字节 = 上半页，后 8 字节 = 下半页
 */
static const uint8_t Font8x16[][16] = {
    {0x00,0xE0,0x10,0x08,0x08,0x10,0xE0,0x00, 0x00,0x0F,0x10,0x20,0x20,0x10,0x0F,0x00}, /*0*/
    {0x00,0x00,0x10,0x10,0xF8,0x00,0x00,0x00, 0x00,0x00,0x20,0x20,0x3F,0x20,0x20,0x00}, /*1*/
    {0x00,0x70,0x08,0x08,0x08,0x08,0xF0,0x00, 0x00,0x30,0x28,0x24,0x22,0x21,0x30,0x00}, /*2*/
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    {0x00,0xF0,0x08,0x08,0x08,0x10,0xE0,0x00, 0x00,0x01,0x12,0x22,0x22,0x11,0x0F,0x00}, /*9*/
};

/* ================================================================
 * 底层 I2C 写（对照参考项目 OLED_WriteByte / OLED_WriteBuffer）
 * ================================================================ */
static void WriteByte(uint8_t cmd, uint8_t data)
{
    uint8_t buf[2] = { cmd, data };
    HAL_I2C_Master_Transmit(&hi2c1, SSD1306_ADDR << 1, buf, 2, I2C_TIMEOUT);
}

static void WriteBuffer(uint8_t cmd, const uint8_t *data, uint16_t len)
{
    uint8_t buf[129];
    buf[0] = cmd;
    for (uint16_t i = 0; i < len && i < 128; i++)
        buf[i + 1] = data[i];
    HAL_I2C_Master_Transmit(&hi2c1, SSD1306_ADDR << 1, buf, len + 1, I2C_TIMEOUT);
}

/* 设置写入位置（页 + 列），对照参考项目 OLED_SetPos */
static void SetPos(uint8_t page, uint8_t col)
{
    uint8_t pos[3] = {
        0xB0 + page,
        ((col & 0xF0) >> 4) | 0x10,
        col & 0x0F
    };
    WriteBuffer(SSD1306_CMD, pos, 3);
}

/* 全屏填充，对照参考项目 OLED_Fill */
static void FillScreen(uint8_t fill)
{
    uint8_t row[128];
    memset(row, fill, 128);
    for (uint8_t m = 0; m < 8; m++) {
        SetPos(m, 0);
        WriteBuffer(SSD1306_DATA, row, 128);
    }
}

/* ================================================================
 * 初始化 — 命令序列逐字节对照参考项目 OLED_Init
 * ================================================================ */
void SSD1306_Init(void)
{
    HAL_Delay(100);

    /* 检测设备 */
    uint8_t dummy = 0;
    while (HAL_I2C_Master_Transmit(&hi2c1, SSD1306_ADDR << 1, &dummy, 0, I2C_TIMEOUT) != HAL_OK);

    WriteByte(SSD1306_CMD, 0xAE);  /* 显示关闭 */
    WriteByte(SSD1306_CMD, 0x20);  /* 设置内存寻址模式 */
    WriteByte(SSD1306_CMD, 0x02);  /* 页寻址模式 */
    WriteByte(SSD1306_CMD, 0xB0);  /* 页起始地址 */
    WriteByte(SSD1306_CMD, 0xA1);  /* 段重映射(左右) */
    WriteByte(SSD1306_CMD, 0xC8);  /* COM扫描方向(上下) */
    WriteByte(SSD1306_CMD, 0x00);  /* 列地址低4位 */
    WriteByte(SSD1306_CMD, 0x10);  /* 列地址高4位 */
    WriteByte(SSD1306_CMD, 0x40);  /* 起始行地址 */
    WriteByte(SSD1306_CMD, 0x81);  /* 对比度控制 */
    WriteByte(SSD1306_CMD, 0xFF);  /* 对比度最大值 */
    WriteByte(SSD1306_CMD, 0xA1);  /* SEG映射 */
    WriteByte(SSD1306_CMD, 0xA6);  /* 正常显示(非反白) */
    WriteByte(SSD1306_CMD, 0xA8);  /* 复用比 */
    WriteByte(SSD1306_CMD, 0x3F);  /* 64行 */
    WriteByte(SSD1306_CMD, 0xA4);  /* 恢复RAM内容显示 */
    WriteByte(SSD1306_CMD, 0xD3);  /* 显示偏移 */
    WriteByte(SSD1306_CMD, 0x00);
    WriteByte(SSD1306_CMD, 0xD5);  /* 时钟分频/振荡器 */
    WriteByte(SSD1306_CMD, 0xF0);
    WriteByte(SSD1306_CMD, 0xD9);  /* 预充电周期 */
    WriteByte(SSD1306_CMD, 0x22);
    WriteByte(SSD1306_CMD, 0xDA);  /* COM引脚配置 */
    WriteByte(SSD1306_CMD, 0x12);
    WriteByte(SSD1306_CMD, 0xDB);  /* VCOMH取消选择 */
    WriteByte(SSD1306_CMD, 0x20);
    WriteByte(SSD1306_CMD, 0x8D);  /* DC-DC使能 */
    WriteByte(SSD1306_CMD, 0x14);
    WriteByte(SSD1306_CMD, 0xAF);  /* 显示开启 */

    FillScreen(0x00);  /* 清屏 */
}

void SSD1306_ClearBuffer(void)  { FillScreen(0x00); }
void SSD1306_UpdateScreen(void) { /* 直接写模式，无需刷新 */ }

/* ================================================================
 * 显示 6x8 字符 — 对照参考项目 OLED_ShowChar(TEXTSIZE_F6X8)
 * 参数：page=页地址(0-7), col=列地址(0-127)
 * ================================================================ */
void SSD1306_ShowChar_6x8(uint8_t page, uint8_t col, char ch)
{
    if (ch < ' ' || ch > '~') ch = ' ';
    uint32_t idx = ch - ' ';

    SetPos(page, col);
    for (uint8_t i = 0; i < 6; i++)
        WriteByte(SSD1306_DATA, Font6x8[idx][i]);
}

/* ================================================================
 * 显示 8x16 字符 — 对照参考项目 OLED_ShowChar(TEXTSIZE_F8X16)
 * 仅支持数字 0-9，占用 2 页（上半页 + 下半页）
 * ================================================================ */
void SSD1306_ShowChar_8x16(uint8_t page, uint8_t col, char ch)
{
    if (ch < '0' || ch > '9') return;
    uint32_t idx = ch - '0';

    /* 上半页 */
    SetPos(page, col);
    for (uint8_t i = 0; i < 8; i++)
        WriteByte(SSD1306_DATA, Font8x16[idx][i]);

    /* 下半页 */
    SetPos(page + 1, col);
    for (uint8_t i = 0; i < 8; i++)
        WriteByte(SSD1306_DATA, Font8x16[idx][i + 8]);
}

/* ================================================================
 * 显示 6x8 字符串
 * x=列, y=像素行(0-63), color 保留参数
 * ================================================================ */
void SSD1306_ShowString_6x8(uint8_t x, uint8_t y, const char *str, uint8_t color)
{
    (void)color;
    uint8_t page = y / 8;
    while (*str) {
        SSD1306_ShowChar_6x8(page, x, *str++);
        x += 6;
        if (x > 122) break;
    }
}

/* ================================================================
 * 显示 8x16 字符串（仅数字）
 * ================================================================ */
void SSD1306_ShowString_8x16(uint8_t x, uint8_t y, const char *str, uint8_t color)
{
    (void)color;
    uint8_t page = y / 8;
    while (*str) {
        SSD1306_ShowChar_8x16(page, x, *str++);
        x += 8;
        if (x > 120) break;
    }
}

/* ================================================================
 * 显示数字（自动格式化）
 * font_size=1: 6x8, font_size=2: 8x16
 * ================================================================ */
void SSD1306_ShowNum(uint8_t x, uint8_t y, int32_t num, uint8_t len, uint8_t font_size)
{
    char buf[12];
    uint8_t i;

    if (num < 0) num = 0;
    if (num > 999) num = 999;

    for (i = 0; i < len; i++) {
        buf[len - 1 - i] = '0' + (num % 10);
        num /= 10;
    }
    buf[len] = '\0';

    if (font_size == 1)
        SSD1306_ShowString_6x8(x, y, buf, 1);
    else
        SSD1306_ShowString_8x16(x, y, buf, 1);
}
